## conf/machine/dm8000.conf
```bitbake
#@TYPE: Machine
#@NAME: Dreambox DM 8000 HD PVR
#@DESCRIPTION: Machine configuration for the Dreambox DM 8000 HD PVR

SOC_FAMILY = "bcm7400"
CHIPSET = "bcm7400"

BRAND_OEM = "dreambox"
MACHINE_BRAND = "DREAMBOX"
MACHINE_NAME = "DM8000HD"

MTD_KERNEL = "mtd2"
MTD_ROOTFS = "mtd0"
KERNEL_FILE = "N/A"
ROOTFS_FILE = "rootfs.bin"

MACHINE_FEATURES += " pci dvb-c wlan kernelwifi externalwifi blindscan-dvbc frontprocessor ci dvd colorlcd128 smallflash DVI SCART YUV RCA"

require conf/machine/include/dreambox-nand-256mb.inc
require conf/machine/include/dreambox-part-256mb.inc
require conf/machine/include/dreambox-ubi.inc
require conf/machine/include/dreambox-mips32el.inc

DVBMEDIASINK_CONFIG = "--with-pcm --with-wma --with-wmv --with-dtsdownmix --with-eac3 --with-amr --with-limited-mpeg4v2"


MACHINE_EXTRA_RRECOMMENDS += "dreambox-enigma2-config dreambox-bootlogo"
```
